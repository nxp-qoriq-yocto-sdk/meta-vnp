## conf/layer.conf
```bitbake
# We have a conf and classes directory, add to BBPATH
BBPATH .= ":${LAYERDIR}"

# We have recipes-* directories, add to BBFILES
BBFILES += "${LAYERDIR}/recipes-*/*/*.bb \
            ${LAYERDIR}/recipes-*/*/*.bbappend"

BBFILE_COLLECTIONS += "meta-vnp"
BBFILE_PATTERN_meta-vnp = "^${LAYERDIR}/"
BBFILE_PRIORITY_meta-vnp = "10"
#LAYERSERIES_COMPAT_meta-vnp = "sumo"
```

## conf/machine/ls1043avnpevb.conf
```bitbake
#@TYPE: Machine
#@NAME: NXP LS1043AVNPEVB board
#@SOC: LSCH2
#@DESCRIPTION: Machine configuration for NXP QorIQ LS1043AVNPEVB
#              with ARM Cortext-A53 core
#@MAINTAINER: Ting Liu <ting.liu@nxp.com>

MACHINEOVERRIDES =. "fsl-lsch2:ls1043a:"

require conf/machine/include/qoriq-arm64.inc
require conf/machine/include/arm/arch-arm64.inc

KERNEL_CLASSES  = " kernel-itbimage "
KERNEL_IMAGETYPES = "itbImage"

DTB_LOAD = "0x90000000"
UBOOT_ENTRYPOINT = "0x80080000"

UBOOT_CONFIG ??= "nor"
UBOOT_CONFIG[nor] = "ls1043adcm_defconfig,,u-boot-dtb.bin"

KERNEL_DEVICETREE ?= "freescale/fsl-ls1043a-rdb-sdk.dtb freescale/fsl-ls1043a-rdb-usdpaa.dtb"
KERNEL_DEFCONFIG ?= "defconfig"

QE_UCODE = "iram_Type_A_LS1021a_r1.0.bin"
EXTRA_IMAGEDEPENDS += "fm-ucode rcw ppa ppa-optee qe-ucode uefi"
USE_VT = "0"
```

## conf/machine/ls1043avnprdb.conf
```bitbake
#@TYPE: Machine
#@NAME: NXP LS1043AVNPRDB board
#@SOC: LSCH2
#@DESCRIPTION: Machine configuration for NXP QorIQ LS1043AVNPRDB
#              with ARM Cortext-A53 core
#@MAINTAINER: Ting Liu <ting.liu@nxp.com>

MACHINEOVERRIDES =. "fsl-lsch2:ls1043a:ls1043avnpevb:"

require conf/machine/include/qoriq-arm64.inc
require conf/machine/include/arm/arch-arm64.inc

KERNEL_CLASSES  = " kernel-itbimage "
KERNEL_IMAGETYPES = "itbImage"

DTB_LOAD = "0x90000000"
UBOOT_ENTRYPOINT = "0x80080000"

UBOOT_CONFIG ??= "qspi nand emmc"
UBOOT_CONFIG[qspi] = "ls1043avnprdb_qspi_defconfig,,u-boot-dtb.bin"
UBOOT_CONFIG[nand] = "ls1043avnprdb_nand_defconfig,,u-boot-with-spl-pbl.bin"
UBOOT_CONFIG[emmc] = "ls1043avnprdb_emmc_defconfig,,u-boot-with-spl-pbl.bin"

KERNEL_DEVICETREE ?= "freescale/fsl-ls1043a-rdb-sdk.dtb freescale/fsl-ls1043a-rdb-usdpaa.dtb"
KERNEL_DEFCONFIG ?= "defconfig"

QE_UCODE = "iram_Type_A_LS1021a_r1.0.bin"
EXTRA_IMAGEDEPENDS += "fm-ucode rcw ppa ppa-optee qe-ucode uefi"
USE_VT = "0"
```
